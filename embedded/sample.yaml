## embedded/sample.yaml
```yaml
sample:
  description: SmartWatch
  name: SmartWatch
common:
  tags: introduction
  integration_platforms:
    - native_posix
  harness: console
  harness_config:
    type: one_line
    regex:
      - "Hello World! (.*)"
tests:
  sample.basic.helloworld:
    tags: introduction
```
